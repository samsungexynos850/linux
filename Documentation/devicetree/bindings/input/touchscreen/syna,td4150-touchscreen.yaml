## Documentation/devicetree/bindings/input/touchscreen/syna,td4150-touchscreen.yaml
```yaml
# SPDX-License-Identifier: (GPL-2.0-only OR BSD-2-Clause)
%YAML 1.2
---
$id: http://devicetree.org/schemas/input/touchscreen/syna,td4150-touchscreen.yaml#
$schema: http://devicetree.org/meta-schemas/core.yaml#

title: Synaptics TD4150 touch controller

maintainers:
  - Thomas Turner <tturner@lineageos.org>

description:
  The TD4150 is a touch and display driver integration (TDDI) chip, now sold
  by OmniVision. Its touch controller talks the Synaptics TouchComm protocol
  over SPI. It has no flash for its application firmware, which the host
  downloads to it on every power up.

allOf:
  - $ref: touchscreen.yaml#
  - $ref: /schemas/spi/spi-peripheral-props.yaml#

properties:
  compatible:
    const: syna,td4150-touchscreen

  reg:
    maxItems: 1

  interrupts:
    maxItems: 1

  spi-cpha: true
  spi-cpol: true

  reset-gpios:
    maxItems: 1

  vdd-supply:
    description: Digital core supply

  vddio-supply:
    description: Host interface supply

  firmware-name:
    maxItems: 1
    description:
      File name of the firmware image to download, defaults to
      td4150_a21s.bin

  wakeup-source: true

required:
  - compatible
  - reg
  - interrupts

unevaluatedProperties: false

examples:
  - |
    #include <dt-bindings/gpio/gpio.h>
    #include <dt-bindings/interrupt-controller/irq.h>

    spi {
        #address-cells = <1>;
        #size-cells = <0>;

        touchscreen@0 {
            compatible = "syna,td4150-touchscreen";
            reg = <0>;
            spi-max-frequency = <7000000>;
            spi-cpol;
            spi-cpha;
            interrupt-parent = <&gpa0>;
            interrupts = <0 IRQ_TYPE_LEVEL_LOW>;
            reset-gpios = <&gpg2 3 GPIO_ACTIVE_LOW>;
            wakeup-source;
        };
    };
```

## Documentation/devicetree/bindings/mfd/samsung,s2mpb03.yaml
```yaml
# SPDX-License-Identifier: (GPL-2.0-only OR BSD-2-Clause)
%YAML 1.2
---
$id: http://devicetree.org/schemas/mfd/samsung,s2mpb03.yaml#
$schema: http://devicetree.org/meta-schemas/core.yaml#

title: Samsung S2MPB03 Power Management IC

maintainers:
  - Thomas Turner <tturner@lineageos.org>

description:
  The Samsung S2MPB03 is a companion PMIC with 7 LDOs, connected over I2C.
  Smartphones use it to power their cameras.

properties:
  compatible:
    const: samsung,s2mpb03

  reg:
    maxItems: 1

  regulators:
    type: object
    description:
      List of child nodes that specify the regulators.

    patternProperties:
      "^ldo[1-7]$":
        type: object
        $ref: /schemas/regulator/regulator.yaml#
        unevaluatedProperties: false

    additionalProperties: false

required:
  - compatible
  - reg
  - regulators

additionalProperties: false

examples:
  - |
    i2c {
        #address-cells = <1>;
        #size-cells = <0>;

        pmic@56 {
            compatible = "samsung,s2mpb03";
            reg = <0x56>;

            regulators {
                ldo1 {
                    regulator-name = "cam0_vldo1";
                    regulator-min-microvolt = <1050000>;
                    regulator-max-microvolt = <1050000>;
                };

                ldo5 {
                    regulator-name = "cam0_vldo5";
                    regulator-min-microvolt = <2800000>;
                    regulator-max-microvolt = <2800000>;
                };
            };
        };
    };
```

## Documentation/devicetree/bindings/mfd/samsung,s2mpu12-pmic.yaml
```yaml
# SPDX-License-Identifier: GPL-2.0-only OR BSD-2-Clause
%YAML 1.2
---
$id: http://devicetree.org/schemas/mfd/samsung,s2mpu12-pmic.yaml#
$schema: http://devicetree.org/meta-schemas/core.yaml#

title: Samsung S2MPU12 Power Management IC

maintainers:
  - Thomas Turner <tturner@lineageos.org>

description: |
  The Samsung S2MPU12 is the main Power Management IC (PMIC) for the Exynos850
  SoC, with 5 buck converters, 36 LDOs, an RTC and a power key input. It also
  contains the audio codec of the SoC.

  It is reached through the ACPM firmware, so it is described as a child of
  the ACPM IPC node.

properties:
  compatible:
    const: samsung,s2mpu12-pmic

  interrupts:
    maxItems: 1

  regulators:
    type: object
    description:
      List of child nodes that specify the regulators.

    patternProperties:
      "^(buck[1-5]|ldo([1-9]|[12][0-9]|3[0-6]))$":
        type: object
        $ref: /schemas/regulator/regulator.yaml#
        unevaluatedProperties: false

    additionalProperties: false

  system-power-controller: true

  wakeup-source: true

required:
  - compatible
  - interrupts

additionalProperties: false

examples:
  - |
    #include <dt-bindings/interrupt-controller/arm-gic.h>
    #include <dt-bindings/interrupt-controller/irq.h>

    pmic {
        compatible = "samsung,s2mpu12-pmic";
        interrupts = <GIC_SPI 56 IRQ_TYPE_LEVEL_HIGH>;
        system-power-controller;
        wakeup-source;

        regulators {
            buck1 {
                regulator-name = "vdd_cpu";
                regulator-min-microvolt = <500000>;
                regulator-max-microvolt = <1200000>;
                regulator-always-on;
            };
        };
    };
```

## Documentation/devicetree/bindings/mfd/samsung,s2mu106-pmic.yaml
```yaml
# SPDX-License-Identifier: GPL-2.0-only OR BSD-2-Clause
%YAML 1.2
---
$id: http://devicetree.org/schemas/mfd/samsung,s2mu106-pmic.yaml#
$schema: http://devicetree.org/meta-schemas/core.yaml#

title: Samsung S2MU106 Power Management IC

maintainers:
  - Thomas Turner <tturner@lineageos.org>

description: |
  The S2MU106 is a companion power management IC which includes subdevices
  for a battery charger, an MUIC (Micro USB Interface Controller), a power
  meter, flash LED and haptic controllers. This node describes the main I2C
  address, which hosts the interrupt controller and the battery charger. The
  battery fuel gauge has its own I2C address and is described separately.

allOf:
  - $ref: /schemas/power/supply/power-supply.yaml#

properties:
  compatible:
    const: samsung,s2mu106-pmic

  reg:
    maxItems: 1

  interrupts:
    maxItems: 1

required:
  - compatible
  - reg

unevaluatedProperties: false

examples:
  - |
    #include <dt-bindings/interrupt-controller/irq.h>

    i2c {
      #address-cells = <1>;
      #size-cells = <0>;

      pmic@3d {
        compatible = "samsung,s2mu106-pmic";
        reg = <0x3d>;

        interrupt-parent = <&gpa2>;
        interrupts = <5 IRQ_TYPE_LEVEL_LOW>;
      };
    };
```

## Documentation/devicetree/bindings/power/supply/samsung,s2mu106-fuel-gauge.yaml
```yaml
# SPDX-License-Identifier: (GPL-2.0-only OR BSD-2-Clause)
%YAML 1.2
---
$id: http://devicetree.org/schemas/power/supply/samsung,s2mu106-fuel-gauge.yaml#
$schema: http://devicetree.org/meta-schemas/core.yaml#

title: Samsung S2MU106 PMIC Battery Fuel Gauge

maintainers:
  - Thomas Turner <tturner@lineageos.org>

description:
  The S2MU106 PMIC integrates a battery fuel gauge with its own I2C address,
  which tracks the battery state of charge with a coulomb counter and a
  battery model. The gauge is powered by the battery and keeps its state
  across reboots, the battery model is only programmed after it was reset.

allOf:
  - $ref: power-supply.yaml#

properties:
  compatible:
    const: samsung,s2mu106-fuel-gauge

  reg:
    maxItems: 1

  interrupts:
    description: Low battery and low voltage alert.
    maxItems: 1

  wakeup-source: true

  shunt-resistor-micro-ohms:
    description:
      Value of the current sense resistor. The factory trim of the gauge
      assumes 10 mOhm.
    enum: [5000, 10000]
    default: 10000

  samsung,battery-capacity:
    $ref: /schemas/types.yaml#/definitions/uint8-array
    description:
      Capacity parameters of the battery model, as provided by Samsung for
      the battery pack.
    minItems: 4
    maxItems: 4

  samsung,battery-model:
    $ref: /schemas/types.yaml#/definitions/uint8-array
    description:
      Battery model tables, as provided by Samsung for the battery pack.
    minItems: 110
    maxItems: 110

dependencies:
  samsung,battery-capacity: [ 'samsung,battery-model' ]
  samsung,battery-model: [ 'samsung,battery-capacity' ]

required:
  - compatible
  - reg

unevaluatedProperties: false

examples:
  - |
    #include <dt-bindings/interrupt-controller/irq.h>

    i2c {
      #address-cells = <1>;
      #size-cells = <0>;

      fuel-gauge@3b {
        compatible = "samsung,s2mu106-fuel-gauge";
        reg = <0x3b>;

        interrupt-parent = <&gpa3>;
        interrupts = <0 IRQ_TYPE_EDGE_BOTH>;
        wakeup-source;

        monitored-battery = <&battery>;
        shunt-resistor-micro-ohms = <5000>;
      };
    };
```
