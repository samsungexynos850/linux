// SPDX-License-Identifier: GPL-2.0
/*
 * Samsung Galaxy A21s (SM-A217F) (6GB) device tree source
 *
 * Copyright (c), 2026, Thomas Turner <tturner@lineageos.org>
 */

/dts-v1/;
#include "exynos850-a217f-common.dtsi"

/ {
	model = "Samsung Galaxy A21s (A217F) (6GB)";
	compatible = "samsung,a217f", "samsung,a217f-6gb", "samsung,exynos850";

	memory@80000000 {
		device_type = "memory";
		reg = <0x0 0x80000000 0x3c900000>,
		      <0x0 0xc0000000 0x20000000>,
		      <0x0 0xe0d00000 0x1f300000>,
		      <0x8 0x80000000 0x20000000>,
		      <0x8 0xa0000000 0x20000000>,
		      <0x8 0xc0000000 0x20000000>,
		      <0x8 0xe0000000 0x20000000>,
		      <0x9 0x00000000 0x20000000>,
		      <0x9 0x20000000 0x20000000>,
		      <0x9 0x40000000 0x20000000>,
		      <0x9 0x60000000 0x20000000>;
	};
};
